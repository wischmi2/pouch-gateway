## build_gateway/gateway/Kconfig/soc/Kconfig
```kconfig
# Load Zephyr SoC Kconfig descriptions.
osource "C:/Users/Brian/pouch_gateway_clean/zephyr/soc/xlnx/zynqmp/Kconfig"
osource "C:/Users/Brian/pouch_gateway_clean/zephyr/soc/xlnx/zynq7000/Kconfig"
osource "C:/Users/Brian/pouch_gateway_clean/zephyr/soc/xlnx/versalnet/Kconfig"
osource "C:/Users/Brian/pouch_gateway_clean/zephyr/soc/xlnx/versal2/Kconfig"
osource "C:/Users/Brian/pouch_gateway_clean/zephyr/soc/xen/Kconfig"
osource "C:/Users/Brian/pouch_gateway_clean/zephyr/soc/wch/ch32v/Kconfig"
osource "C:/Users/Brian/pouch_gateway_clean/zephyr/soc/ti/simplelink/Kconfig"
osource "C:/Users/Brian/pouch_gateway_clean/zephyr/soc/ti/mspm0/Kconfig"
osource "C:/Users/Brian/pouch_gateway_clean/zephyr/soc/ti/lm3s6965/Kconfig"
osource "C:/Users/Brian/pouch_gateway_clean/zephyr/soc/ti/k3/Kconfig"
osource "C:/Users/Brian/pouch_gateway_clean/zephyr/soc/telink/tlsr/Kconfig"
osource "C:/Users/Brian/pouch_gateway_clean/zephyr/soc/starfive/jh71xx/Kconfig"
osource "C:/Users/Brian/pouch_gateway_clean/zephyr/soc/st/stm32/Kconfig"
osource "C:/Users/Brian/pouch_gateway_clean/zephyr/soc/snps/qemu_arc/Kconfig"
osource "C:/Users/Brian/pouch_gateway_clean/zephyr/soc/snps/nsim/arc_v/Kconfig"
osource "C:/Users/Brian/pouch_gateway_clean/zephyr/soc/snps/nsim/arc_classic/Kconfig"
osource "C:/Users/Brian/pouch_gateway_clean/zephyr/soc/snps/hsdk4xd/Kconfig"
osource "C:/Users/Brian/pouch_gateway_clean/zephyr/soc/snps/hsdk/Kconfig"
osource "C:/Users/Brian/pouch_gateway_clean/zephyr/soc/snps/emsk/Kconfig"
osource "C:/Users/Brian/pouch_gateway_clean/zephyr/soc/snps/emsdp/Kconfig"
osource "C:/Users/Brian/pouch_gateway_clean/zephyr/soc/snps/arc_iot/Kconfig"
osource "C:/Users/Brian/pouch_gateway_clean/zephyr/soc/silabs/Kconfig"
osource "C:/Users/Brian/pouch_gateway_clean/zephyr/soc/sifive/sifive_freedom/Kconfig"
osource "C:/Users/Brian/pouch_gateway_clean/zephyr/soc/sensry/Kconfig"
osource "C:/Users/Brian/pouch_gateway_clean/zephyr/soc/rockchip/Kconfig"
osource "C:/Users/Brian/pouch_gateway_clean/zephyr/soc/renode/riscv_virtual/Kconfig"
osource "C:/Users/Brian/pouch_gateway_clean/zephyr/soc/renode/cortex_r8_virtual/Kconfig"
osource "C:/Users/Brian/pouch_gateway_clean/zephyr/soc/renesas/smartbond/Kconfig"
osource "C:/Users/Brian/pouch_gateway_clean/zephyr/soc/renesas/rz/Kconfig"
osource "C:/Users/Brian/pouch_gateway_clean/zephyr/soc/renesas/rx/Kconfig"
osource "C:/Users/Brian/pouch_gateway_clean/zephyr/soc/renesas/rcar/Kconfig"
osource "C:/Users/Brian/pouch_gateway_clean/zephyr/soc/renesas/ra/Kconfig"
osource "C:/Users/Brian/pouch_gateway_clean/zephyr/soc/realtek/ec/Kconfig"
osource "C:/Users/Brian/pouch_gateway_clean/zephyr/soc/raspberrypi/rpi_pico/Kconfig"
osource "C:/Users/Brian/pouch_gateway_clean/zephyr/soc/quicklogic/eos_s3/Kconfig"
osource "C:/Users/Brian/pouch_gateway_clean/zephyr/soc/qemu/virt_riscv/Kconfig"
osource "C:/Users/Brian/pouch_gateway_clean/zephyr/soc/qemu/malta/Kconfig"
osource "C:/Users/Brian/pouch_gateway_clean/zephyr/soc/openisa/rv32m1/Kconfig"
osource "C:/Users/Brian/pouch_gateway_clean/zephyr/soc/openhwgroup/cva6/Kconfig"
osource "C:/Users/Brian/pouch_gateway_clean/zephyr/soc/oct/osd32mp15x/Kconfig"
osource "C:/Users/Brian/pouch_gateway_clean/zephyr/soc/nxp/s32/Kconfig"
osource "C:/Users/Brian/pouch_gateway_clean/zephyr/soc/nxp/rw/Kconfig"
osource "C:/Users/Brian/pouch_gateway_clean/zephyr/soc/nxp/mcx/Kconfig"
osource "C:/Users/Brian/pouch_gateway_clean/zephyr/soc/nxp/lpc/Kconfig"
osource "C:/Users/Brian/pouch_gateway_clean/zephyr/soc/nxp/layerscape/Kconfig"
osource "C:/Users/Brian/pouch_gateway_clean/zephyr/soc/nxp/kinetis/Kconfig"
osource "C:/Users/Brian/pouch_gateway_clean/zephyr/soc/nxp/imxrt/Kconfig"
osource "C:/Users/Brian/pouch_gateway_clean/zephyr/soc/nxp/imx/Kconfig"
osource "C:/Users/Brian/pouch_gateway_clean/zephyr/soc/nuvoton/numicro/Kconfig"
osource "C:/Users/Brian/pouch_gateway_clean/zephyr/soc/nuvoton/numaker/Kconfig"
osource "C:/Users/Brian/pouch_gateway_clean/zephyr/soc/nuvoton/npcx/Kconfig"
osource "C:/Users/Brian/pouch_gateway_clean/zephyr/soc/nuvoton/npcm/Kconfig"
osource "C:/Users/Brian/pouch_gateway_clean/zephyr/soc/nordic/Kconfig"
osource "C:/Users/Brian/pouch_gateway_clean/zephyr/soc/neorv32/Kconfig"
osource "C:/Users/Brian/pouch_gateway_clean/zephyr/soc/native/inf_clock/Kconfig"
osource "C:/Users/Brian/pouch_gateway_clean/zephyr/soc/microchip/sam/Kconfig"
osource "C:/Users/Brian/pouch_gateway_clean/zephyr/soc/microchip/miv/Kconfig"
osource "C:/Users/Brian/pouch_gateway_clean/zephyr/soc/microchip/mec/Kconfig"
osource "C:/Users/Brian/pouch_gateway_clean/zephyr/soc/mediatek/mt8xxx/Kconfig"
osource "C:/Users/Brian/pouch_gateway_clean/zephyr/soc/lowrisc/opentitan/Kconfig"
osource "C:/Users/Brian/pouch_gateway_clean/zephyr/soc/litex/litex_vexriscv/Kconfig"
osource "C:/Users/Brian/pouch_gateway_clean/zephyr/soc/ite/ec/Kconfig"
osource "C:/Users/Brian/pouch_gateway_clean/zephyr/soc/intel/raptor_lake/Kconfig"
osource "C:/Users/Brian/pouch_gateway_clean/zephyr/soc/intel/lakemont/Kconfig"
osource "C:/Users/Brian/pouch_gateway_clean/zephyr/soc/intel/intel_socfpga_std/Kconfig"
osource "C:/Users/Brian/pouch_gateway_clean/zephyr/soc/intel/intel_socfpga/Kconfig"
osource "C:/Users/Brian/pouch_gateway_clean/zephyr/soc/intel/intel_niosv/Kconfig"
osource "C:/Users/Brian/pouch_gateway_clean/zephyr/soc/intel/intel_ish/Kconfig"
osource "C:/Users/Brian/pouch_gateway_clean/zephyr/soc/intel/intel_adsp/Kconfig"
osource "C:/Users/Brian/pouch_gateway_clean/zephyr/soc/intel/elkhart_lake/Kconfig"
osource "C:/Users/Brian/pouch_gateway_clean/zephyr/soc/intel/atom/Kconfig"
osource "C:/Users/Brian/pouch_gateway_clean/zephyr/soc/intel/apollo_lake/Kconfig"
osource "C:/Users/Brian/pouch_gateway_clean/zephyr/soc/intel/alder_lake/Kconfig"
osource "C:/Users/Brian/pouch_gateway_clean/zephyr/soc/infineon/cat3/Kconfig"
osource "C:/Users/Brian/pouch_gateway_clean/zephyr/soc/infineon/cat1c/Kconfig"
osource "C:/Users/Brian/pouch_gateway_clean/zephyr/soc/infineon/cat1b/Kconfig"
osource "C:/Users/Brian/pouch_gateway_clean/zephyr/soc/infineon/cat1a/Kconfig"
osource "C:/Users/Brian/pouch_gateway_clean/zephyr/soc/gd/gd32/Kconfig"
osource "C:/Users/Brian/pouch_gateway_clean/zephyr/soc/gaisler/leon3/Kconfig"
osource "C:/Users/Brian/pouch_gateway_clean/zephyr/soc/gaisler/gr716a/Kconfig"
osource "C:/Users/Brian/pouch_gateway_clean/zephyr/soc/espressif/Kconfig"
osource "C:/Users/Brian/pouch_gateway_clean/zephyr/soc/ene/kb1200/Kconfig"
osource "C:/Users/Brian/pouch_gateway_clean/zephyr/soc/efinix/sapphire/Kconfig"
osource "C:/Users/Brian/pouch_gateway_clean/zephyr/soc/cdns/xtensa_sample_controller/Kconfig"
osource "C:/Users/Brian/pouch_gateway_clean/zephyr/soc/cdns/sample_controller32/Kconfig"
osource "C:/Users/Brian/pouch_gateway_clean/zephyr/soc/cdns/dc233c/Kconfig"
osource "C:/Users/Brian/pouch_gateway_clean/zephyr/soc/brcm/bcmvk/Kconfig"
osource "C:/Users/Brian/pouch_gateway_clean/zephyr/soc/brcm/bcm2712/Kconfig"
osource "C:/Users/Brian/pouch_gateway_clean/zephyr/soc/brcm/bcm2711/Kconfig"
osource "C:/Users/Brian/pouch_gateway_clean/zephyr/soc/bflb/Kconfig"
osource "C:/Users/Brian/pouch_gateway_clean/zephyr/soc/atmel/sam0/Kconfig"
osource "C:/Users/Brian/pouch_gateway_clean/zephyr/soc/atmel/sam/Kconfig"
osource "C:/Users/Brian/pouch_gateway_clean/zephyr/soc/aspeed/Kconfig"
osource "C:/Users/Brian/pouch_gateway_clean/zephyr/soc/arm/Kconfig"
osource "C:/Users/Brian/pouch_gateway_clean/zephyr/soc/arm/beetle/Kconfig"
osource "C:/Users/Brian/pouch_gateway_clean/zephyr/soc/antmicro/myra/Kconfig"
osource "C:/Users/Brian/pouch_gateway_clean/zephyr/soc/andestech/Kconfig"
osource "C:/Users/Brian/pouch_gateway_clean/zephyr/soc/amd/acp_6_0/Kconfig"
osource "C:/Users/Brian/pouch_gateway_clean/zephyr/soc/ambiq/Kconfig"
osource "C:/Users/Brian/pouch_gateway_clean/zephyr/soc/aesc/Kconfig"
osource "C:/Users/Brian/pouch_gateway_clean/zephyr/soc/adi/max32/Kconfig"
osource "C:/Users/Brian/pouch_gateway_clean/nrf/soc/sercomm/nrf91/Kconfig"
osource "C:/Users/Brian/pouch_gateway_clean/nrf/soc/nordic/Kconfig"
```

## build_gateway/mcuboot/Kconfig/Kconfig.sysbuild.modules
```kconfig
config ZEPHYR_POUCH_GATEWAY_MODULE
   bool
   default y
config ZEPHYR_GOLIOTH_FIRMWARE_SDK_MODULE
   bool
   default y
config ZEPHYR_POUCH_MODULE
   bool
   default y
menu "nrf (C:/Users/Brian/pouch_gateway_clean/nrf)"
osource "C:/Users/Brian/pouch_gateway_clean/nrf/sysbuild/Kconfig.sysbuild"
config ZEPHYR_NRF_MODULE
	bool
	default y
endmenu
config ZEPHYR_MCUBOOT_MODULE
   bool
   default y
config ZEPHYR_MBEDTLS_MODULE
   bool
   default y
config ZEPHYR_OBERON_PSA_CRYPTO_MODULE
   bool
   default y
config ZEPHYR_TRUSTED_FIRMWARE_M_MODULE
   bool
   default y
config ZEPHYR_CMSIS_6_MODULE
   bool
   default y
config ZEPHYR_HAL_NORDIC_MODULE
   bool
   default y
config ZEPHYR_LITTLEFS_MODULE
   bool
   default y
config ZEPHYR_SEGGER_MODULE
   bool
   default y
config ZEPHYR_ZCBOR_MODULE
   bool
   default y
config ZEPHYR_NRFXLIB_MODULE
   bool
   default y
```

## build_gateway/mcuboot/Kconfig/boards/Kconfig
```kconfig
# Load Zephyr board Kconfig descriptions.
osource "C:/Users/Brian/pouch_gateway_clean/zephyr/boards/nordic/nrf9160dk/Kconfig"
config BOARD_REVISION_0_14_0
	def_bool y
```
