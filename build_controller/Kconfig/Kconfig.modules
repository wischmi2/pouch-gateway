## build_controller/Kconfig/Kconfig.modules
```kconfig
menu "pouch-gateway (C:/Users/Brian/pouch_gateway_clean/pouch-gateway)"
osource "C:/Users/Brian/pouch_gateway_clean/pouch-gateway/Kconfig"
config ZEPHYR_POUCH_GATEWAY_MODULE
	bool
	default y
endmenu
menu "golioth-firmware-sdk (C:/Users/Brian/pouch_gateway_clean/modules/lib/golioth-firmware-sdk)"
osource "C:/Users/Brian/pouch_gateway_clean/modules/lib/golioth-firmware-sdk/port/zephyr/Kconfig"
config ZEPHYR_GOLIOTH_FIRMWARE_SDK_MODULE
	bool
	default y
endmenu
menu "pouch (C:/Users/Brian/pouch_gateway_clean/pouch)"
osource "C:/Users/Brian/pouch_gateway_clean/pouch/Kconfig"
config ZEPHYR_POUCH_MODULE
	bool
	default y
endmenu
menu "nrf (C:/Users/Brian/pouch_gateway_clean/nrf)"
osource "C:/Users/Brian/pouch_gateway_clean/nrf/Kconfig.nrf"
config ZEPHYR_NRF_MODULE
	bool
	default y
endmenu
menu "mcuboot (C:/Users/Brian/pouch_gateway_clean/bootloader/mcuboot)"
osource "$(ZEPHYR_MCUBOOT_KCONFIG)"
config ZEPHYR_MCUBOOT_MODULE
	bool
	default y
endmenu
menu "mbedtls (C:/Users/Brian/pouch_gateway_clean/modules/crypto/mbedtls)"
osource "$(ZEPHYR_MBEDTLS_KCONFIG)"
config ZEPHYR_MBEDTLS_MODULE
	bool
	default y
endmenu
menu "oberon-psa-crypto (C:/Users/Brian/pouch_gateway_clean/modules/crypto/oberon-psa-crypto)"
osource "C:/Users/Brian/pouch_gateway_clean/modules/crypto/oberon-psa-crypto/Kconfig.oberon_psa_crypto"
config ZEPHYR_OBERON_PSA_CRYPTO_MODULE
	bool
	default y
endmenu
menu "trusted-firmware-m (C:/Users/Brian/pouch_gateway_clean/modules/tee/tf-m/trusted-firmware-m)"
osource "$(ZEPHYR_TRUSTED_FIRMWARE_M_KCONFIG)"
config ZEPHYR_TRUSTED_FIRMWARE_M_MODULE
	bool
	default y
endmenu
menu "cmsis_6 (C:/Users/Brian/pouch_gateway_clean/modules/hal/cmsis_6)"
osource "$(ZEPHYR_CMSIS_6_KCONFIG)"
config ZEPHYR_CMSIS_6_MODULE
	bool
	default y
endmenu
menu "hal_nordic (C:/Users/Brian/pouch_gateway_clean/modules/hal/nordic)"
osource "$(ZEPHYR_HAL_NORDIC_KCONFIG)"
config ZEPHYR_HAL_NORDIC_MODULE
	bool
	default y

config ZEPHYR_HAL_NORDIC_MODULE_BLOBS
	bool
endmenu
menu "littlefs (C:/Users/Brian/pouch_gateway_clean/modules/fs/littlefs)"
osource "$(ZEPHYR_LITTLEFS_KCONFIG)"
config ZEPHYR_LITTLEFS_MODULE
	bool
	default y
endmenu
menu "segger (C:/Users/Brian/pouch_gateway_clean/modules/debug/segger)"
osource "$(ZEPHYR_SEGGER_KCONFIG)"
config ZEPHYR_SEGGER_MODULE
	bool
	default y
endmenu
menu "zcbor (C:/Users/Brian/pouch_gateway_clean/modules/lib/zcbor)"
osource "$(ZEPHYR_ZCBOR_KCONFIG)"
config ZEPHYR_ZCBOR_MODULE
	bool
	default y
endmenu
menu "nrfxlib (C:/Users/Brian/pouch_gateway_clean/nrfxlib)"
osource "C:/Users/Brian/pouch_gateway_clean/nrfxlib/Kconfig.nrfxlib"
config ZEPHYR_NRFXLIB_MODULE
	bool
	default y
endmenu
```

## build_controller/Kconfig/Kconfig.shield
```kconfig
osource "C:/Users/Brian/pouch_gateway_clean/pouch-gateway/boards/shields/*/Kconfig.shield"
osource "C:/Users/Brian/pouch_gateway_clean/modules/lib/golioth-firmware-sdk/zephyr/boards/shields/*/Kconfig.shield"
osource "C:/Users/Brian/pouch_gateway_clean/nrf/boards/shields/*/Kconfig.shield"
```

## build_controller/Kconfig/boards/Kconfig.nrf9160dk
```kconfig
# Load board Kconfig descriptions.
osource "C:/Users/Brian/pouch_gateway_clean/zephyr/boards/nordic/nrf9160dk/Kconfig.nrf9160dk"
```

## build_controller/controller/Kconfig/arch/Kconfig
```kconfig
# Load Zephyr Arch Kconfig descriptions.
osource "C:/Users/Brian/pouch_gateway_clean/zephyr/arch/rx/Kconfig"
osource "C:/Users/Brian/pouch_gateway_clean/zephyr/arch/x86/Kconfig"
osource "C:/Users/Brian/pouch_gateway_clean/zephyr/arch/xtensa/Kconfig"
osource "C:/Users/Brian/pouch_gateway_clean/zephyr/arch/sparc/Kconfig"
osource "C:/Users/Brian/pouch_gateway_clean/zephyr/arch/riscv/Kconfig"
osource "C:/Users/Brian/pouch_gateway_clean/zephyr/arch/posix/Kconfig"
osource "C:/Users/Brian/pouch_gateway_clean/zephyr/arch/mips/Kconfig"
osource "C:/Users/Brian/pouch_gateway_clean/zephyr/arch/arm64/Kconfig"
osource "C:/Users/Brian/pouch_gateway_clean/zephyr/arch/arm/Kconfig"
osource "C:/Users/Brian/pouch_gateway_clean/zephyr/arch/arc/Kconfig"
```

## build_gateway/Kconfig/soc/Kconfig.defconfig
```kconfig
# Load Zephyr SoC defconfig descriptions.
osource "C:/Users/Brian/pouch_gateway_clean/zephyr/soc/xlnx/zynqmp/Kconfig.defconfig"
osource "C:/Users/Brian/pouch_gateway_clean/zephyr/soc/xlnx/zynq7000/Kconfig.defconfig"
osource "C:/Users/Brian/pouch_gateway_clean/zephyr/soc/xlnx/versalnet/Kconfig.defconfig"
osource "C:/Users/Brian/pouch_gateway_clean/zephyr/soc/xlnx/versal2/Kconfig.defconfig"
osource "C:/Users/Brian/pouch_gateway_clean/zephyr/soc/xen/Kconfig.defconfig"
osource "C:/Users/Brian/pouch_gateway_clean/zephyr/soc/wch/ch32v/Kconfig.defconfig"
osource "C:/Users/Brian/pouch_gateway_clean/zephyr/soc/ti/simplelink/Kconfig.defconfig"
osource "C:/Users/Brian/pouch_gateway_clean/zephyr/soc/ti/mspm0/Kconfig.defconfig"
osource "C:/Users/Brian/pouch_gateway_clean/zephyr/soc/ti/lm3s6965/Kconfig.defconfig"
osource "C:/Users/Brian/pouch_gateway_clean/zephyr/soc/ti/k3/Kconfig.defconfig"
osource "C:/Users/Brian/pouch_gateway_clean/zephyr/soc/telink/tlsr/Kconfig.defconfig"
osource "C:/Users/Brian/pouch_gateway_clean/zephyr/soc/starfive/jh71xx/Kconfig.defconfig"
osource "C:/Users/Brian/pouch_gateway_clean/zephyr/soc/st/stm32/Kconfig.defconfig"
osource "C:/Users/Brian/pouch_gateway_clean/zephyr/soc/snps/qemu_arc/Kconfig.defconfig"
osource "C:/Users/Brian/pouch_gateway_clean/zephyr/soc/snps/nsim/arc_v/Kconfig.defconfig"
osource "C:/Users/Brian/pouch_gateway_clean/zephyr/soc/snps/nsim/arc_classic/Kconfig.defconfig"
osource "C:/Users/Brian/pouch_gateway_clean/zephyr/soc/snps/hsdk4xd/Kconfig.defconfig"
osource "C:/Users/Brian/pouch_gateway_clean/zephyr/soc/snps/hsdk/Kconfig.defconfig"
osource "C:/Users/Brian/pouch_gateway_clean/zephyr/soc/snps/emsk/Kconfig.defconfig"
osource "C:/Users/Brian/pouch_gateway_clean/zephyr/soc/snps/emsdp/Kconfig.defconfig"
osource "C:/Users/Brian/pouch_gateway_clean/zephyr/soc/snps/arc_iot/Kconfig.defconfig"
osource "C:/Users/Brian/pouch_gateway_clean/zephyr/soc/silabs/Kconfig.defconfig"
osource "C:/Users/Brian/pouch_gateway_clean/zephyr/soc/sifive/sifive_freedom/Kconfig.defconfig"
osource "C:/Users/Brian/pouch_gateway_clean/zephyr/soc/sensry/Kconfig.defconfig"
osource "C:/Users/Brian/pouch_gateway_clean/zephyr/soc/rockchip/Kconfig.defconfig"
osource "C:/Users/Brian/pouch_gateway_clean/zephyr/soc/renode/riscv_virtual/Kconfig.defconfig"
osource "C:/Users/Brian/pouch_gateway_clean/zephyr/soc/renode/cortex_r8_virtual/Kconfig.defconfig"
osource "C:/Users/Brian/pouch_gateway_clean/zephyr/soc/renesas/smartbond/Kconfig.defconfig"
osource "C:/Users/Brian/pouch_gateway_clean/zephyr/soc/renesas/rz/Kconfig.defconfig"
osource "C:/Users/Brian/pouch_gateway_clean/zephyr/soc/renesas/rx/Kconfig.defconfig"
osource "C:/Users/Brian/pouch_gateway_clean/zephyr/soc/renesas/rcar/Kconfig.defconfig"
osource "C:/Users/Brian/pouch_gateway_clean/zephyr/soc/renesas/ra/Kconfig.defconfig"
osource "C:/Users/Brian/pouch_gateway_clean/zephyr/soc/realtek/ec/Kconfig.defconfig"
osource "C:/Users/Brian/pouch_gateway_clean/zephyr/soc/raspberrypi/rpi_pico/Kconfig.defconfig"
osource "C:/Users/Brian/pouch_gateway_clean/zephyr/soc/quicklogic/eos_s3/Kconfig.defconfig"
osource "C:/Users/Brian/pouch_gateway_clean/zephyr/soc/qemu/virt_riscv/Kconfig.defconfig"
osource "C:/Users/Brian/pouch_gateway_clean/zephyr/soc/qemu/malta/Kconfig.defconfig"
osource "C:/Users/Brian/pouch_gateway_clean/zephyr/soc/openisa/rv32m1/Kconfig.defconfig"
osource "C:/Users/Brian/pouch_gateway_clean/zephyr/soc/openhwgroup/cva6/Kconfig.defconfig"
osource "C:/Users/Brian/pouch_gateway_clean/zephyr/soc/oct/osd32mp15x/Kconfig.defconfig"
osource "C:/Users/Brian/pouch_gateway_clean/zephyr/soc/nxp/s32/Kconfig.defconfig"
osource "C:/Users/Brian/pouch_gateway_clean/zephyr/soc/nxp/rw/Kconfig.defconfig"
osource "C:/Users/Brian/pouch_gateway_clean/zephyr/soc/nxp/mcx/Kconfig.defconfig"
osource "C:/Users/Brian/pouch_gateway_clean/zephyr/soc/nxp/lpc/Kconfig.defconfig"
osource "C:/Users/Brian/pouch_gateway_clean/zephyr/soc/nxp/layerscape/Kconfig.defconfig"
osource "C:/Users/Brian/pouch_gateway_clean/zephyr/soc/nxp/kinetis/Kconfig.defconfig"
osource "C:/Users/Brian/pouch_gateway_clean/zephyr/soc/nxp/imxrt/Kconfig.defconfig"
osource "C:/Users/Brian/pouch_gateway_clean/zephyr/soc/nxp/imx/Kconfig.defconfig"
osource "C:/Users/Brian/pouch_gateway_clean/zephyr/soc/nuvoton/numicro/Kconfig.defconfig"
osource "C:/Users/Brian/pouch_gateway_clean/zephyr/soc/nuvoton/numaker/Kconfig.defconfig"
osource "C:/Users/Brian/pouch_gateway_clean/zephyr/soc/nuvoton/npcx/Kconfig.defconfig"
osource "C:/Users/Brian/pouch_gateway_clean/zephyr/soc/nuvoton/npcm/Kconfig.defconfig"
osource "C:/Users/Brian/pouch_gateway_clean/zephyr/soc/nordic/Kconfig.defconfig"
osource "C:/Users/Brian/pouch_gateway_clean/zephyr/soc/neorv32/Kconfig.defconfig"
osource "C:/Users/Brian/pouch_gateway_clean/zephyr/soc/native/inf_clock/Kconfig.defconfig"
osource "C:/Users/Brian/pouch_gateway_clean/zephyr/soc/microchip/sam/Kconfig.defconfig"
osource "C:/Users/Brian/pouch_gateway_clean/zephyr/soc/microchip/miv/Kconfig.defconfig"
osource "C:/Users/Brian/pouch_gateway_clean/zephyr/soc/microchip/mec/Kconfig.defconfig"
osource "C:/Users/Brian/pouch_gateway_clean/zephyr/soc/mediatek/mt8xxx/Kconfig.defconfig"
osource "C:/Users/Brian/pouch_gateway_clean/zephyr/soc/lowrisc/opentitan/Kconfig.defconfig"
osource "C:/Users/Brian/pouch_gateway_clean/zephyr/soc/litex/litex_vexriscv/Kconfig.defconfig"
osource "C:/Users/Brian/pouch_gateway_clean/zephyr/soc/ite/ec/Kconfig.defconfig"
osource "C:/Users/Brian/pouch_gateway_clean/zephyr/soc/intel/raptor_lake/Kconfig.defconfig"
osource "C:/Users/Brian/pouch_gateway_clean/zephyr/soc/intel/lakemont/Kconfig.defconfig"
osource "C:/Users/Brian/pouch_gateway_clean/zephyr/soc/intel/intel_socfpga_std/Kconfig.defconfig"
osource "C:/Users/Brian/pouch_gateway_clean/zephyr/soc/intel/intel_socfpga/Kconfig.defconfig"
osource "C:/Users/Brian/pouch_gateway_clean/zephyr/soc/intel/intel_niosv/Kconfig.defconfig"
osource "C:/Users/Brian/pouch_gateway_clean/zephyr/soc/intel/intel_ish/Kconfig.defconfig"
osource "C:/Users/Brian/pouch_gateway_clean/zephyr/soc/intel/intel_adsp/Kconfig.defconfig"
osource "C:/Users/Brian/pouch_gateway_clean/zephyr/soc/intel/elkhart_lake/Kconfig.defconfig"
osource "C:/Users/Brian/pouch_gateway_clean/zephyr/soc/intel/atom/Kconfig.defconfig"
osource "C:/Users/Brian/pouch_gateway_clean/zephyr/soc/intel/apollo_lake/Kconfig.defconfig"
osource "C:/Users/Brian/pouch_gateway_clean/zephyr/soc/intel/alder_lake/Kconfig.defconfig"
osource "C:/Users/Brian/pouch_gateway_clean/zephyr/soc/infineon/cat3/Kconfig.defconfig"
osource "C:/Users/Brian/pouch_gateway_clean/zephyr/soc/infineon/cat1c/Kconfig.defconfig"
osource "C:/Users/Brian/pouch_gateway_clean/zephyr/soc/infineon/cat1b/Kconfig.defconfig"
osource "C:/Users/Brian/pouch_gateway_clean/zephyr/soc/infineon/cat1a/Kconfig.defconfig"
osource "C:/Users/Brian/pouch_gateway_clean/zephyr/soc/gd/gd32/Kconfig.defconfig"
osource "C:/Users/Brian/pouch_gateway_clean/zephyr/soc/gaisler/leon3/Kconfig.defconfig"
osource "C:/Users/Brian/pouch_gateway_clean/zephyr/soc/gaisler/gr716a/Kconfig.defconfig"
osource "C:/Users/Brian/pouch_gateway_clean/zephyr/soc/espressif/Kconfig.defconfig"
osource "C:/Users/Brian/pouch_gateway_clean/zephyr/soc/ene/kb1200/Kconfig.defconfig"
osource "C:/Users/Brian/pouch_gateway_clean/zephyr/soc/efinix/sapphire/Kconfig.defconfig"
osource "C:/Users/Brian/pouch_gateway_clean/zephyr/soc/cdns/xtensa_sample_controller/Kconfig.defconfig"
osource "C:/Users/Brian/pouch_gateway_clean/zephyr/soc/cdns/sample_controller32/Kconfig.defconfig"
osource "C:/Users/Brian/pouch_gateway_clean/zephyr/soc/cdns/dc233c/Kconfig.defconfig"
osource "C:/Users/Brian/pouch_gateway_clean/zephyr/soc/brcm/bcmvk/Kconfig.defconfig"
osource "C:/Users/Brian/pouch_gateway_clean/zephyr/soc/brcm/bcm2712/Kconfig.defconfig"
osource "C:/Users/Brian/pouch_gateway_clean/zephyr/soc/brcm/bcm2711/Kconfig.defconfig"
osource "C:/Users/Brian/pouch_gateway_clean/zephyr/soc/bflb/Kconfig.defconfig"
osource "C:/Users/Brian/pouch_gateway_clean/zephyr/soc/atmel/sam0/Kconfig.defconfig"
osource "C:/Users/Brian/pouch_gateway_clean/zephyr/soc/atmel/sam/Kconfig.defconfig"
osource "C:/Users/Brian/pouch_gateway_clean/zephyr/soc/aspeed/Kconfig.defconfig"
osource "C:/Users/Brian/pouch_gateway_clean/zephyr/soc/arm/Kconfig.defconfig"
osource "C:/Users/Brian/pouch_gateway_clean/zephyr/soc/arm/beetle/Kconfig.defconfig"
osource "C:/Users/Brian/pouch_gateway_clean/zephyr/soc/antmicro/myra/Kconfig.defconfig"
osource "C:/Users/Brian/pouch_gateway_clean/zephyr/soc/andestech/Kconfig.defconfig"
osource "C:/Users/Brian/pouch_gateway_clean/zephyr/soc/amd/acp_6_0/Kconfig.defconfig"
osource "C:/Users/Brian/pouch_gateway_clean/zephyr/soc/ambiq/Kconfig.defconfig"
osource "C:/Users/Brian/pouch_gateway_clean/zephyr/soc/aesc/Kconfig.defconfig"
osource "C:/Users/Brian/pouch_gateway_clean/zephyr/soc/adi/max32/Kconfig.defconfig"
osource "C:/Users/Brian/pouch_gateway_clean/nrf/soc/sercomm/nrf91/Kconfig.defconfig"
osource "C:/Users/Brian/pouch_gateway_clean/nrf/soc/nordic/Kconfig.defconfig"
```

## build_gateway/gateway/Kconfig/boards/Kconfig.defconfig
```kconfig
# Load Zephyr board defconfig descriptions.
osource "C:/Users/Brian/pouch_gateway_clean/zephyr/boards/nordic/nrf9160dk/Kconfig.defconfig"
```

## build_gateway/gateway/Kconfig/boards/Kconfig.sysbuild
```kconfig
# Load Sysbuild board Kconfig descriptions.
osource "C:/Users/Brian/pouch_gateway_clean/zephyr/boards/nordic/nrf9160dk/Kconfig.sysbuild"
```
